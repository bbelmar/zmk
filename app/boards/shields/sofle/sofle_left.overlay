#include "sofle.dtsi"

&kscan0 {
    col-gpios
        = <&pro_micro 19 GPIO_ACTIVE_HIGH>
        , <&pro_micro 18 GPIO_ACTIVE_HIGH>
        , <&pro_micro 15 GPIO_ACTIVE_HIGH>
        , <&pro_micro 14 GPIO_ACTIVE_HIGH>
        , <&pro_micro 16 GPIO_ACTIVE_HIGH>
        , <&pro_micro 10 GPIO_ACTIVE_HIGH>
        ;
};

&left_encoder {
    status = "okay";
};

/ {
    sensors: sensors {
        compatible = "zmk,keymap-sensors";
        sensors = <&left_encoder>;
        triggers-per-rotation = <12>;   // try 12 → 8 if still too “slippery”
    };
};

&left_encoder {
    status = "okay";
    // Optional but recommended if not set in sofle.dtsi:
    // a-gpios = <&pro_micro PIN_A (GPIO_ACTIVE_HIGH | GPIO_PULL_UP)>;
    // b-gpios = <&pro_micro PIN_B (GPIO_ACTIVE_HIGH | GPIO_PULL_UP)>;
};
